## conf/distro/auto-agl.conf
```bitbake
require ${QTI_METAPATH_DISTRO}/conf/distro/auto-agl.conf

PRODUCT = "${@'${MACHINE}' if 'coqos' in d.getVar('MACHINE') else 'sa81x5agl'}"
DEPLOY_NAME_BASE = "${PRODUCT}-automotive"

# Enable bluetooth features
DISTRO_FEATURES_append = " qti-bluetooth"

# Add selinux and related features
DISTRO_FEATURES_append = " acl xattr pam selinux opengl"
PREFERRED_PROVIDER_virtual/refpolicy ?= "refpolicy-minimum"
PREFERRED_VERSION_refpolicy = "2.20190201"
IMAGE_INSTALL_append = " packagegroup-core-selinux"
```
